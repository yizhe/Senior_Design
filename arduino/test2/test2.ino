#include <avr/pgmspace.h>
const int len = 14193;
const short int signal[len] PROGMEM = 
{200, 171, 200, 171, 200, 229, 200, 229, 250, 229, 
250, 229, 250, 286, 250, 286, 250, 286, 250, 286, 
250, 286, 250, 229, 250, 229, 200, 229, 200, 171, 
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171, 200, 171};

short int interval, interval_old = 0,i;
unsigned int index[] = {0,0,0,0};
int mask = B11111111;
void setup() {
  Serial.begin(9600);
  cli();
  DDRB |= mask;
  DDRE |= mask;
  DDRH |= mask;
  DDRL |= mask;
//configure timer1 for pwm generation
  TCCR0A = 0;
  TCCR0B = 0;
  TCCR1A = 0;
  TCCR1B = 0;
  TCCR1C = 0;
  TCCR3A = 0;
  TCCR3B = 0;
  TCCR3C = 0;
  TCCR4A = 0;
  TCCR4B = 0;
  TCCR4C = 0;
  TCCR5A = 0;
  TCCR5B = 0;
  TCCR4C = 0;
  
 //WGM1(3:0)=1111 fast pwm mode; CS1(2:0)=001 16Mhz clk not prescaled
 //COM1B(1:0) = 11 set oc1b on compare match
  TCCR1A = _BV(COM1B1) | _BV(COM1B0) | _BV(WGM11) | _BV(WGM10); 
  TCCR1B = _BV(WGM13) | _BV(WGM12);
  TCCR3A = _BV(COM3B1) | _BV(COM3B0) | _BV(WGM31) | _BV(WGM30); 
  TCCR3B = _BV(WGM33) | _BV(WGM32);
  TCCR4A = _BV(COM4B1) | _BV(COM4B0) | _BV(WGM41) | _BV(WGM40); 
  TCCR4B = _BV(WGM43) | _BV(WGM42);
  TCCR5A = _BV(COM5B1) | _BV(COM5B0) | _BV(WGM51) | _BV(WGM50); 
  TCCR5B = _BV(WGM53) | _BV(WGM52);
 //TCCR1A = B1011xx11 ; TCCR1B = B00011001
  
  
  //TCNT counts from O to OCR1A. 
  //if TCNT > OCR1B, output = High; else output = low;
  OCR1A = 400;
  OCR1B = 100;
  OCR3A = 400;
  OCR3B = 100;
  OCR4A = 400;
  OCR4B = 100;
  OCR5A = 400;
  OCR5B = 100;
  
  //enable output compare A interupt
  sei();
  TIMSK0 |= _BV(OCIE0A);
  TIMSK1 |= _BV(OCIE1A);//enable ISR(timer1) when TCNT1 reaches top
  TIMSK3 |= _BV(OCIE3A);
  TIMSK4 |= _BV(OCIE4A);
  TIMSK5 |= _BV(OCIE5A);

}


ISR(TIMER1_COMPA_vect) //iterate through sequence of values 
{
  //read data from program memory 
  OCR1B = pgm_read_word_near((index[0]) + signal);
  ++index[0];

}


ISR(TIMER3_COMPA_vect){
  OCR3B = pgm_read_word_near((index[1]) + signal);
  ++index[1];
  
}

ISR(TIMER4_COMPA_vect){
  OCR4B = pgm_read_word_near((index[2]) + signal);
  ++index[2];
  
}

ISR(TIMER5_COMPA_vect){
  OCR5B = pgm_read_word_near((index[3]) + signal);
  ++index[3];
}

void loop() {
  // put your main code here, to run repeatedly:
  
  if (Serial.available() > 0){
    interval = Serial.read();
    interval -= 48;   
  }
  if (interval_old != interval){
    interval_old = interval;
    if (interval == 0){
      TCCR1B &= ~_BV(CS10);
      TCCR3B &= ~_BV(CS30);
      TCCR4B &= ~_BV(CS40);
      TCCR5B &= ~_BV(CS50);
      TCNT1 = 0; TCNT3 = 0; TCNT4 = 0; TCNT5 = 0;
      for (i=0; i<4; ++i){
        index[i] = 0;
      }
    }else{
      
      Serial.println(interval);
      micros();
      TCCR1B |= _BV(CS10);
      for (i=0; i< interval; ++i){
        micros();  
      } 
      TCCR3B |= _BV(CS30);
      for (i=0; i<interval; ++i){
        micros();  
      } 
      TCCR4B |= _BV(CS40);
      for (i=0; i<interval; ++i){
        micros();  
      } 
      TCCR5B |= _BV(CS50);
    }
  }
      

}
